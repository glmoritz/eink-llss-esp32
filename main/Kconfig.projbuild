## main/Kconfig.projbuild
```kconfig
menu "LLSS e-Ink Client Configuration"

    config LLSS_SERVER_URL
        string "LLSS Server URL"
        default "https://eink.tutu.eng.br/api"
        help
            The base URL for the Low Level Screen Service API.

    config LLSS_WIFI_AP_SSID_PREFIX
        string "WiFi AP SSID Prefix"
        default "LLSS-"
        help
            Prefix for the WiFi Access Point SSID used during provisioning.

    config LLSS_DEFAULT_POLL_MS
        int "Default poll interval (ms)"
        default 5000
        range 1000 60000
        help
            Default interval between device state polls to the LLSS server.

    config LLSS_EPD_WIDTH
        int "EPD Width (pixels)"
        default 800
        help
            E-Paper display width in pixels.

    config LLSS_EPD_HEIGHT
        int "EPD Height (pixels)"
        default 480
        help
            E-Paper display height in pixels.

endmenu
```

## sdkconfig.defaults
```kconfig
# LLSS e-Ink Client - SDK Configuration Defaults

CONFIG_COMPILER_OPTIMIZATION_SIZE=y
CONFIG_COMPILER_CXX_EXCEPTIONS=y
CONFIG_COMPILER_CXX_EXCEPTIONS_EMG_POOL_SIZE=1024

CONFIG_BOOTLOADER_COMPILER_OPTIMIZATION_PERF=y
CONFIG_BOOTLOADER_LOG_LEVEL_WARN=y

CONFIG_HTTPD_MAX_REQ_HDR_LEN=1024
CONFIG_HTTPD_MAX_URI_LEN=512

CONFIG_PARTITION_TABLE_SINGLE_APP_LARGE=y

CONFIG_ESP_TASK_WDT_TIMEOUT_S=10

CONFIG_ESP_MAIN_TASK_STACK_SIZE=8192
CONFIG_MBEDTLS_DYNAMIC_BUFFER=y
CONFIG_MBEDTLS_SSL_KEEP_PEER_CERTIFICATE=n
CONFIG_ESP_WIFI_IRAM_OPT=n
CONFIG_ESP_WIFI_RX_IRAM_OPT=n
CONFIG_ESP_WIFI_DYNAMIC_RX_MGMT_BUFFER=y
CONFIG_ESP_WIFI_STATIC_RX_BUFFER_NUM=6
CONFIG_ESP_WIFI_DYNAMIC_RX_BUFFER_NUM=8
CONFIG_NEWLIB_NANO_FORMAT=y
CONFIG_ESP_WIFI_ENTERPRISE_SUPPORT=n

CONFIG_MBEDTLS_SSL_RENEGOTIATION=n

# TLS certificate bundle for HTTPS
CONFIG_MBEDTLS_CERTIFICATE_BUNDLE=y
CONFIG_MBEDTLS_CERTIFICATE_BUNDLE_DEFAULT_FULL=y

# ESP HTTP Client
CONFIG_ESP_HTTP_CLIENT_ENABLE_HTTPS=y
```
